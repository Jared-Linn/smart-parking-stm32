#include "BH1750.h"
#include "i2c.h"
#include "delay.h"
#include "oled.h"
#include "usart1.h"

float result_lx=0;
uint8_t BUF[2]={0};
uint16_t result1750=0;

/**************************************************************
*功  能：	端口初始化
*参  数：	无
*返回值：	无 
**************************************************************/
void Init_BH1750(void)
{
	i2c_Port_Init(); 
}

/**************************************************************
*功  能：	发送设备地址
*参  数：	无
*返回值：	无 
**************************************************************/
void Cmd_Write_BH1750(uint8_t cmd)
{
	//起始信号
    I2C_Start();
	//发送设备地址+写信号
    I2C_Send_Byte(BH1750_Addr+0);	
	while(I2C_Wait_Ack());
	//内部寄存器地址
    I2C_Send_Byte(cmd);				
	while(I2C_Wait_Ack());
	//内部寄存器数据，
    //BH1750_SendByte(REG_data);
    //发送停止信号	
    I2C_Stop();						
	Delay_ms(5);
}

/**************************************************************
*功  能：	开启一次H分辨率模式
*参  数：	无
*返回值：	无 
**************************************************************/
void Start_BH1750(void)
{
	//power on
	Cmd_Write_BH1750(BH1750_ON);
    //clear	
	Cmd_Write_BH1750(BH1750_RSET);
    //一次H分辨率模式，至少120ms，之后自动断电模式  	
	Cmd_Write_BH1750(BH1750_ONE);  		
}

/**************************************************************
*功  能：	读光照信号
*参  数：	无
*返回值：	无 
**************************************************************/
void Read_BH1750(void)
{   	
	//起始信号
    I2C_Start();
	//发送设备地址+读信号
    I2C_Send_Byte(BH1750_Addr+1);	
	while(I2C_Wait_Ack());
	//发送ACK
	BUF[0]=I2C_Read_Byte(1);
    //发送NACK	
	BUF[1]=I2C_Read_Byte(0);
    //停止信号	
    I2C_Stop();						
    Delay_ms(5);
}

/**************************************************************
*功  能：	合成光照数据
*参  数：	无
*返回值：	无 
**************************************************************/
void Convert_BH1750(void)
{
	result1750=BUF[0];
	//合成数据，即光照数据
	result1750=(result1750<<8)+BUF[1];		
	result1750=(float)result1750/1.2;
}

/**************************************************************
*功  能：	显示光照数据
*参  数：	无
*返回值：	无 
**************************************************************/
void BH1750_Test()
{
	//power on
	Start_BH1750();
    //延时120ms	
    Delay_ms(120);     						
   
	//连续读取结果 到BUF里面 
    Read_BH1750(); 
    //转换结果到result_lx	
    Convert_BH1750();  						
	OLED_ShowInt32Num(55,4,result1750,5,16);
	
}
//										endfile
